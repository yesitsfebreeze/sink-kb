## config/boards/shields/bloq/Kconfig.defconfig
```kconfig
if SHIELD_BLOQ_LEFT

config ZMK_BATTERY_REPORTING
	default n

config ZMK_KEYBOARD_NAME
	default "bloq"

config ZMK_SPLIT_ROLE_CENTRAL
	default y

endif

if SHIELD_BLOQ_LEFT || SHIELD_BLOQ_RIGHT

config ZMK_SPLIT
	default y
endif
```

## config/boards/shields/cygnus/Kconfig.defconfig
```kconfig
if SHIELD_ZQET_LEFT

config ZMK_BATTERY_REPORTING
	default n

config ZMK_KEYBOARD_NAME
	default "zqet"

config ZMK_SPLIT_ROLE_CENTRAL
	default y

endif

if SHIELD_ZQET_LEFT || SHIELD_ZQET_RIGHT

config ZMK_SPLIT
	default y
endif
```

## config/boards/shields/cygnus/Kconfig.shield
```kconfig
config SHIELD_ZQET_LEFT
    def_bool $(shields_list_contains,zqet_left)

config SHIELD_ZQET_RIGHT
    def_bool $(shields_list_contains,zqet_right)
```

## config/boards/shields/shikakui/Kconfig.defconfig
```kconfig
if SHIELD_SHIKAKUI_LEFT

config ZMK_BATTERY_REPORTING
	default n

config ZMK_KEYBOARD_NAME
	default "shikakui"

config ZMK_SPLIT_ROLE_CENTRAL
	default y

endif

if SHIELD_SHIKAKUI_LEFT || SHIELD_SHIKAKUI_RIGHT

config ZMK_SPLIT
	default y
endif
```

## config/boards/shields/shikakui/Kconfig.shield
```kconfig
config SHIELD_SHIKAKUI_LEFT
    def_bool $(shields_list_contains,shikakui_left)

config SHIELD_SHIKAKUI_RIGHT
    def_bool $(shields_list_contains,shikakui_right)
```
